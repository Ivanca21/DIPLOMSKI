## button_latency/boards/st/my_nucleo_f401re/my_nucleo_f401re_defconfig
```kconfig
# enable MPU
CONFIG_ARM_MPU=y

# Enable hardware stack protection
CONFIG_HW_STACK_PROTECTION=y

# Enable GPIO subsystem
CONFIG_GPIO=y
```

## freertos-zephyr-comparison/zephyr/boards/st/my_nucleo_f401re/Kconfig.my_nucleo_f401re
```kconfig
# SPDX-License-Identifier: Apache-2.0

config BOARD_MY_NUCLEO_F401RE
	select SOC_STM32F401XE
```

## freertos-zephyr-comparison/zephyr/boards/st/my_nucleo_f401re/board.yml
```yaml
board:
  name: my_nucleo_f401re
  full_name: My Minimal Nucleo F401RE
  vendor: st
  socs:
    - name: stm32f401xe
```
